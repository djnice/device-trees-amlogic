#include "gxl_p212_1g.dts"

/ {
	le-dt-id = "gxl_p212_1g_nand";
	nand {
		compatible = "amlogic, aml_nand";
		dev_name = "nand";
		status = "okay";
		reg = <0x0 0xd0074800 0x0 0x200>;
		interrupts = <0x0 0x22 0x1>;
		pinctrl-names = "nand_rb_mod", "nand_norb_mod", "nand_cs_pins_only";
		pinctrl-0 = <0x42 0x43 0x44>;
		pinctrl-1 = <0x42 0x43 0x44>;
		pinctrl-2 = <0x45>;
		device_id = <0x0>;
		plat-names = "nandnormal";
		plat-num = <0x1>;
		plat-part-0 = <0x46>;

		normal {
			enable_pad = "ce0", "ce1", "ce2", "ce3";
			busy_pad = "rb0";
			linux,phandle = <0x46>;
			phandle = <0x46>;
		};
	};
};
